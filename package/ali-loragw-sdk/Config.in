## package/ali-loragw-sdk/Config.in
```kconfig
config BR2_PACKAGE_ALI_LORAGW_SDK
	bool "Ali LoRaGW SDK"
	help
	  More detail. See https://help.aliyun.com/document_detail/97091.html

config BR2_PACKAGE_ALI_LORAGW_SDK_PRODUCT_KEY
        string "Specify Product Key"
        default "a1TGu0u0sby"
        depends on BR2_PACKAGE_ALI_LORAGW_SDK

config BR2_PACKAGE_ALI_LORAGW_SDK_DEVICE_NAME
        string "Specify Device Name"
        default "d896e0fff010b2b2"
        depends on BR2_PACKAGE_ALI_LORAGW_SDK

config BR2_PACKAGE_ALI_LORAGW_SDK_DEVICE_SECRET
        string "Specify Device Secret"
        default "Zft6eLli2E6kJJLyKIPCWTHw6ohZzKFS"
        depends on BR2_PACKAGE_ALI_LORAGW_SDK
```

## package/applications/Config.in
```kconfig
#menu "Applications"

config BR2_PACKAGE_APPLICATIONS
	bool "Applications"
	help
	  Enable this option if you want to build a application for
	  your embedded device

if BR2_PACKAGE_APPLICATIONS

config NUC970_APPLICATIONS
	bool "NUC970 Applications"
	help
	  Enable this option if you want to build a nuc970 application for
	  your embedded device

if NUC970_APPLICATIONS

#config BR2_APPLICATIONS_CUSTOM_REPO_URL
#        string "URL of custom repository"
#        default BR2_APPLICATION_CUSTOM_GIT_REPO_URL \
#                if BR2_APPLICATION_CUSTOM_GIT_REPO_URL != ""  # legacy

#config BR2_APPLICATIONS_CUSTOM_REPO_VERSION
#        string "Custom repository version"
#        default BR2_APPLICATION_CUSTOM_GIT_VERSION \
#                if BR2_APPLICATION_CUSTOM_GIT_VERSION != ""  # legacy
#        help
#          Revision to use in the typical format used by Git/Mercurial/Subversion
#          E.G. a sha id, a tag, branch, ..


# Packages that need to have a kernel with support for loadable modules,
# but do not use the kernel-modules infrastructure, should select that
# option.
config APPLICATIONS_BUILD_DEMOS
	bool "Demos"
	help

config APPLICATIONS_BUILD_PYTHON
	bool "Python-2.7.9"
config APPLICATIONS_BUILD_EMWIN
	bool "EmWin"

#config APPLICATIONS_BUILD_QT
#        bool "QT-everywhere-opensource-src-4.8.5"

config APPLICATIONS_BUILD_YAFFS2UTILS
        bool "Yaffs2utils"

#config APPLICATIONS_BUILD_ETHTOOL
#        bool "Ethtool-4.6"

config APPLICATIONS_BUILD_MINIGUI
        bool "Minigui"

endif # BR2_PACKAGE_APPLICATIONS

config NUC980_APPLICATIONS
        bool "NUC980 Applications"
        help
          Enable this option if you want to build a nuc980 application for
          your embedded device

if NUC980_APPLICATIONS

config NUC980_APPLICATIONS_BUILD_DEMOS
        bool "Demos"
        help

config NUC980_APPLICATIONS_BUILD_YAFFS2UTILS
        bool "Yaffs2utils"

endif #BR2_PACKAGE_NUC980_APPLICATIONS

config NUC980_APPLICATIONS_BUILD_ALLXON
        bool "Allxon Service"
	select NUC980_APPLICATIONS_BUILD_ALLXON_POWERCYCLING
        help
          Allxon provides remote edge AI device management solutions with In-Band and Out-Of-Band services to make monitoring, maintenance, management, deployment, and version updating easy on edge AI device
          fleets.
          Allxon helps save businesses time and money on high on-site operational costs while maintaining business continuity.
          Enable this option to activate Allxon services on your embedded device.
          Select jffs2 root file system settings.
          This service will not be activated by default after booting. You will need to register with Allxon using the device serial number.
          Contact Allxon for the device serial number at support@allxon.com. 

if NUC980_APPLICATIONS_BUILD_ALLXON

config NUC980_APPLICATIONS_BUILD_ALLXON_IHV_INFO
        string "Manufacturer"
        help
          Enter the manufacturer's details to activate Allxon services on this device.

          You may also leave this empty and proceed by pressing [enter]

config NUC980_APPLICATIONS_BUILD_ALLXON_POWERCYCLING
        bool "Power Cycling"
        help
          Allxon swiftDR for Power Cycling is a powerful Out-Of-Band disaster recovery tool that helps you instantly resolve system errors and unresponsive devices by remotely powering OFF and back ON your
          edge AI systems.
          Enable this option to add the Allxon power cycling plugin onto your embedded device.
          Allxon power cycling plugin uses PC08 and PC09 to access the device's power button and reset button.

endif

endif
```

## package/mbed-edge-examples/Config.in
```kconfig
config BR2_PACKAGE_MBED_EDGE_EXAMPLES
	bool "Mbed edge examples"
	select BR2_PACKAGE_MBED_EDGE
	select BR2_PACKAGE_MOSQUITTO
	help
	  https://github.com/ARMmbed/mbed-edge-examples
```

## package/mbed-edge/Config.in
```kconfig
config BR2_PACKAGE_MBED_EDGE
	bool "Mbed edge"
	select BR2_DOXYGEN
	help
	  https://github.com/ARMmbed/mbed-edge
```

## package/semtech-libloragw/Config.in
```kconfig
config BR2_PACKAGE_SEMTECH_LIBLORAGW
	bool "Semtech LoRa GW library"
	help
	  https://github.com/Lora-net/lora_gateway

config BR2_PACKAGE_LIBLORAGW_SPIDEV_PATH
	string "Specify the SPIDEV path"
	default "/dev/spidev1.0"
	depends on BR2_PACKAGE_SEMTECH_LIBLORAGW
	help
	  Specify spidev path
```

## package/semtech-loragw-pkt-fwd/Config.in
```kconfig
config BR2_PACKAGE_SEMTECH_LORAGW_PKT_FWD
	bool "Semtech LoRa GW packet forwarder"
	select BR2_PACKAGE_SEMTECH_LIBLORAGW
	help
	  https://github.com/Lora-net/packet_forwarder
```
